/dts-v1/;
/plugin/;

/ {
	compatible = "rockchip,rk3588";

	fragment@0 {
		target-path = "/csi2-dcphy0";
		__overlay__ {
			status = "okay";
		};
	};

	fragment@1 {
		target-path = "/mipi0-csi2";
		__overlay__ {
			status = "okay";
		};
	};
};
