/dts-v1/;
/plugin/;

/ {
	fragment@0 {
		target = <&uart1>;

		__overlay__ {
			status = "okay";
			dmas = <&dmac0 8>, <&dmac0 9>;
			dma-names = "tx", "rx";
			pinctrl-names = "default";
			pinctrl-0 = <&uart1m1_xfer>;
		};
	};
};
